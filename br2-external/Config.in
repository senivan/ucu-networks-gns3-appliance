## br2-external/Config.in
```kconfig
menu "GNS3 appliance packages"

source "$BR2_EXTERNAL_GNS3_PATH/package/gns3-busybox/Config.in"
source "$BR2_EXTERNAL_GNS3_PATH/package/python-gns3-platformdirs/Config.in"
source "$BR2_EXTERNAL_GNS3_PATH/package/python-gns3-sentry-sdk/Config.in"
source "$BR2_EXTERNAL_GNS3_PATH/package/python-py-cpuinfo/Config.in"
source "$BR2_EXTERNAL_GNS3_PATH/package/python-truststore/Config.in"
source "$BR2_EXTERNAL_GNS3_PATH/package/ubridge/Config.in"
source "$BR2_EXTERNAL_GNS3_PATH/package/vpcs/Config.in"
source "$BR2_EXTERNAL_GNS3_PATH/package/gns3-server/Config.in"

endmenu
```

## br2-external/configs/gns3_proxmox_defconfig
```kconfig
BR2_x86_64=y
BR2_JLEVEL=4
BR2_TOOLCHAIN_BUILDROOT_CXX=y
BR2_KERNEL_HEADERS_AS_KERNEL=y
BR2_PACKAGE_HOST_LINUX_HEADERS_CUSTOM_7_0=y
BR2_GLOBAL_PATCH_DIR="$(BR2_EXTERNAL_GNS3_PATH)/board/gns3/patches"
BR2_DOWNLOAD_FORCE_CHECK_HASHES=y
BR2_TARGET_GENERIC_HOSTNAME="gns3-vm"
BR2_GENERATE_LOCALE="en_US.UTF-8"
BR2_ROOTFS_DEVICE_CREATION_DYNAMIC_EUDEV=y
BR2_ROOTFS_DEVICE_TABLE_SUPPORTS_EXTENDED_ATTRIBUTES=y
BR2_TARGET_GENERIC_ROOT_PASSWD="1"
BR2_TARGET_GENERIC_GETTY_PORT="tty1"
BR2_ROOTFS_OVERLAY="$(BR2_EXTERNAL_GNS3_PATH)/board/gns3/rootfs-overlay"
BR2_ROOTFS_POST_BUILD_SCRIPT="$(BR2_EXTERNAL_GNS3_PATH)/board/gns3/post-build.sh"
BR2_ROOTFS_POST_IMAGE_SCRIPT="support/scripts/genimage.sh $(BR2_EXTERNAL_GNS3_PATH)/board/gns3/post-image-templates.sh $(BR2_EXTERNAL_GNS3_PATH)/board/gns3/post-image-projects.sh"
BR2_ROOTFS_POST_SCRIPT_ARGS="-c $(BR2_EXTERNAL_GNS3_PATH)/board/gns3/genimage-bios.cfg"
BR2_LINUX_KERNEL=y
BR2_LINUX_KERNEL_CUSTOM_VERSION=y
BR2_LINUX_KERNEL_CUSTOM_VERSION_VALUE="7.1.4"
BR2_LINUX_KERNEL_USE_CUSTOM_CONFIG=y
BR2_LINUX_KERNEL_CUSTOM_CONFIG_FILE="$(BR2_EXTERNAL_GNS3_PATH)/board/gns3/linux.config"
BR2_LINUX_KERNEL_INSTALL_TARGET=y
BR2_LINUX_KERNEL_NEEDS_HOST_OPENSSL=y
BR2_LINUX_KERNEL_NEEDS_HOST_LIBELF=y
BR2_PACKAGE_ACPID=y
BR2_PACKAGE_DBUS=y
BR2_PACKAGE_PYTHON3=y
BR2_PACKAGE_PYTHON3_PYEXPAT=y
BR2_PACKAGE_LIBNL=y
BR2_PACKAGE_READLINE=y
BR2_PACKAGE_QEMU=y
BR2_PACKAGE_QEMU_SYSTEM=y
BR2_PACKAGE_QEMU_CHOOSE_TARGETS=y
BR2_PACKAGE_QEMU_TARGET_I386=y
BR2_PACKAGE_QEMU_TARGET_X86_64=y
BR2_PACKAGE_QEMU_TOOLS=y
BR2_PACKAGE_QEMU_GUEST_AGENT=y
BR2_PACKAGE_DHCPCD=y
# BR2_PACKAGE_IFUPDOWN_SCRIPTS is not set
BR2_PACKAGE_IPROUTE2=y
BR2_PACKAGE_IPTABLES_NFTABLES=y
BR2_PACKAGE_IPTABLES_NFTABLES_DEFAULT=y
BR2_PACKAGE_LIBVIRT=y
BR2_PACKAGE_LIBVIRT_DAEMON=y
BR2_PACKAGE_NETCAT_OPENBSD=y
BR2_PACKAGE_NFTABLES=y
BR2_PACKAGE_OPENSSH=y
BR2_PACKAGE_TCPDUMP=y
BR2_PACKAGE_TRACEROUTE=y
BR2_PACKAGE_DOCKER_CLI=y
BR2_PACKAGE_DOCKER_ENGINE=y
BR2_PACKAGE_UTIL_LINUX_AGETTY=y
BR2_PACKAGE_UTIL_LINUX_BINARIES=y
BR2_PACKAGE_UTIL_LINUX_FSCK=y
BR2_PACKAGE_UTIL_LINUX_IPCRM=y
BR2_PACKAGE_UTIL_LINUX_IPCS=y
BR2_PACKAGE_UTIL_LINUX_KILL=y
BR2_PACKAGE_UTIL_LINUX_LOGGER=y
BR2_PACKAGE_UTIL_LINUX_LOGIN=y
BR2_PACKAGE_UTIL_LINUX_LOSETUP=y
BR2_PACKAGE_UTIL_LINUX_MOUNT=y
BR2_PACKAGE_UTIL_LINUX_NSENTER=y
BR2_PACKAGE_UTIL_LINUX_PARTX=y
BR2_PACKAGE_UTIL_LINUX_PIVOT_ROOT=y
BR2_PACKAGE_UTIL_LINUX_SCHEDUTILS=y
BR2_PACKAGE_UTIL_LINUX_SETPRIV=y
BR2_PACKAGE_UTIL_LINUX_SU=y
BR2_PACKAGE_UTIL_LINUX_SULOGIN=y
BR2_PACKAGE_UTIL_LINUX_SWITCH_ROOT=y
BR2_PACKAGE_UTIL_LINUX_UNSHARE=y
BR2_PACKAGE_UTIL_LINUX_WIPEFS=y
BR2_TARGET_ROOTFS_EXT2=y
BR2_TARGET_ROOTFS_EXT2_4=y
BR2_TARGET_ROOTFS_EXT2_SIZE="1G"
# BR2_TARGET_ROOTFS_TAR is not set
BR2_TARGET_GRUB2=y
BR2_TARGET_GRUB2_INSTALL_TOOLS=y
BR2_PACKAGE_HOST_GENIMAGE=y
BR2_PACKAGE_GNS3_SERVER=y
```

## br2-external/package/gns3-busybox/Config.in
```kconfig
config BR2_PACKAGE_GNS3_BUSYBOX
	bool "static BusyBox resource for GNS3 Docker nodes"
	depends on BR2_USE_MMU
	help
	  Build a separate statically linked x86-64 BusyBox for GNS3
	  Docker containers. It is not the appliance's init BusyBox.

	  https://busybox.net/
```

## br2-external/package/gns3-server/Config.in
```kconfig
config BR2_PACKAGE_GNS3_SERVER
	bool "GNS3 Server"
	depends on BR2_USE_MMU
	depends on BR2_TOOLCHAIN_HAS_THREADS
	depends on BR2_PACKAGE_HOST_RUSTC_TARGET_ARCH_SUPPORTS # python-jsonschema
	select BR2_PACKAGE_CA_CERTIFICATES
	select BR2_PACKAGE_DOCKER_CLI
	select BR2_PACKAGE_DOCKER_ENGINE
	select BR2_PACKAGE_GNS3_BUSYBOX
	select BR2_PACKAGE_PYTHON3
	select BR2_PACKAGE_PYTHON3_PYEXPAT
	select BR2_PACKAGE_PYTHON3_SSL
	select BR2_PACKAGE_PYTHON3_UNICODEDATA
	select BR2_PACKAGE_PYTHON3_ZLIB
	select BR2_PACKAGE_PYTHON_AIOFILES
	select BR2_PACKAGE_PYTHON_AIOHTTP
	select BR2_PACKAGE_PYTHON_AIOHTTP_CORS
	select BR2_PACKAGE_PYTHON_ASYNC_TIMEOUT
	select BR2_PACKAGE_PYTHON_DISTRO
	select BR2_PACKAGE_PYTHON_GNS3_PLATFORMDIRS
	select BR2_PACKAGE_PYTHON_GNS3_SENTRY_SDK
	select BR2_PACKAGE_PYTHON_JINJA2
	select BR2_PACKAGE_PYTHON_JSONSCHEMA
	select BR2_PACKAGE_PYTHON_PSUTIL
	select BR2_PACKAGE_PYTHON_PY_CPUINFO
	select BR2_PACKAGE_PYTHON_SIX
	select BR2_PACKAGE_PYTHON_TRUSTSTORE
	select BR2_PACKAGE_QEMU
	select BR2_PACKAGE_QEMU_GUEST_AGENT
	select BR2_PACKAGE_QEMU_SYSTEM
	select BR2_PACKAGE_QEMU_TOOLS
	select BR2_PACKAGE_UBRIDGE
	select BR2_PACKAGE_UTIL_LINUX
	select BR2_PACKAGE_UTIL_LINUX_BINARIES
	select BR2_PACKAGE_VPCS
	help
	  GNS3 network emulation server.

	  https://github.com/GNS3/gns3-server

comment "GNS3 Server needs a toolchain w/ threads and host Rust support"
	depends on BR2_USE_MMU
	depends on !BR2_TOOLCHAIN_HAS_THREADS || \
		!BR2_PACKAGE_HOST_RUSTC_TARGET_ARCH_SUPPORTS
```

## br2-external/package/python-gns3-platformdirs/Config.in
```kconfig
config BR2_PACKAGE_PYTHON_GNS3_PLATFORMDIRS
	bool "python-platformdirs 2.x for GNS3"
	help
	  Platform-specific application directories. This package pins
	  the 2.x API required by GNS3 Server 2.2.60.

	  https://github.com/platformdirs/platformdirs
```

## br2-external/package/python-gns3-sentry-sdk/Config.in
```kconfig
config BR2_PACKAGE_PYTHON_GNS3_SENTRY_SDK
	bool "python-sentry-sdk for GNS3"
	select BR2_PACKAGE_PYTHON_CERTIFI
	select BR2_PACKAGE_PYTHON_URLLIB3
	help
	  Sentry Python SDK at the minimum version required by GNS3
	  Server 2.2.60.

	  https://github.com/getsentry/sentry-python
```

## br2-external/package/python-py-cpuinfo/Config.in
```kconfig
config BR2_PACKAGE_PYTHON_PY_CPUINFO
	bool "python-py-cpuinfo"
	help
	  Python CPU information library used by GNS3.

	  https://github.com/workhorsy/py-cpuinfo
```

## br2-external/package/python-truststore/Config.in
```kconfig
config BR2_PACKAGE_PYTHON_TRUSTSTORE
	bool "python-truststore"
	depends on BR2_PACKAGE_PYTHON3
	select BR2_PACKAGE_PYTHON3_SSL
	help
	  Access to the native system certificate store for Python.

	  https://github.com/sethmlarson/truststore
```

## br2-external/package/ubridge/Config.in
```kconfig
config BR2_PACKAGE_UBRIDGE
	bool "uBridge"
	depends on BR2_USE_MMU
	depends on BR2_TOOLCHAIN_HAS_THREADS
	select BR2_PACKAGE_LIBPCAP
	help
	  Ethernet, TAP and UDP tunnel bridge used by GNS3.

	  https://github.com/GNS3/ubridge

comment "uBridge needs a toolchain w/ threads"
	depends on BR2_USE_MMU
	depends on !BR2_TOOLCHAIN_HAS_THREADS
```

## br2-external/package/vpcs/Config.in
```kconfig
config BR2_PACKAGE_VPCS
	bool "VPCS"
	depends on BR2_USE_MMU
	depends on BR2_TOOLCHAIN_HAS_THREADS
	help
	  Virtual PC Simulator used by GNS3.

	  https://github.com/GNS3/vpcs

comment "VPCS needs a toolchain w/ threads"
	depends on BR2_USE_MMU
	depends on !BR2_TOOLCHAIN_HAS_THREADS
```
